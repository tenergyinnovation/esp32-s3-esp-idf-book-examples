## chapter05/ex03_kconfig_option/main/Kconfig.projbuild
```kconfig
menu "Greenhouse settings"

    config GH_NAME
        string "ชื่อโรงเรือน"
        default "Greenhouse-A"
        help
            ชื่อที่แสดงใน log และส่งขึ้น cloud

    config GH_FAN_ON_TEMP
        int "อุณหภูมิเปิดพัดลม (C)"
        range 20 45
        default 32

    config GH_ENABLE_ALARM
        bool "เปิดสัญญาณเตือนอุณหภูมิสูง"
        default y

endmenu
```

## chapter16/capstone_greenhouse_node/main/Kconfig.projbuild
```kconfig
menu "Example Wi-Fi"
    config EX_WIFI_SSID
        string "Wi-Fi SSID"
        default "Wokwi-GUEST"
        help
            ชื่อ Wi-Fi ที่จะเชื่อมต่อ (Wokwi-GUEST ใช้กับ Wokwi simulator)
    config EX_WIFI_PASSWORD
        string "Wi-Fi password"
        default ""
    config EX_WIFI_MAX_RETRY
        int "จำนวนครั้งที่ลองเชื่อมต่อก่อนยอมแพ้ (0 = ไม่จำกัด)"
        default 0
endmenu

menu "Greenhouse node"
    config NODE_MQTT_URI
        string "MQTT broker URI"
        default "mqtt://broker.emqx.io"
endmenu
```

## chapter16/ex01_ota_https/main/Kconfig.projbuild
```kconfig
menu "Example Wi-Fi"
    config EX_WIFI_SSID
        string "Wi-Fi SSID"
        default "Wokwi-GUEST"
        help
            ชื่อ Wi-Fi ที่จะเชื่อมต่อ (Wokwi-GUEST ใช้กับ Wokwi simulator)
    config EX_WIFI_PASSWORD
        string "Wi-Fi password"
        default ""
    config EX_WIFI_MAX_RETRY
        int "จำนวนครั้งที่ลองเชื่อมต่อก่อนยอมแพ้ (0 = ไม่จำกัด)"
        default 0
endmenu

menu "OTA"
    config EX_OTA_URL
        string "URL ของไฟล์ firmware (.bin)"
        default "https://192.168.1.10:8070/firmware.bin"
endmenu
```
